#Arduino software for controlling robotic ventilating fish model
#Controls 3 servo motors and receives input from two sensors
#Prints servo position and sensor data
#include <Servo.h> 
 
Servo buccalservo; 
Servo operservo;                
Servo brmservo;

long prevmillis = 0;
long pressureinterval = 10; // this must always be less than servointerval

long prevmillisservo = 0;
long servointerval = 15;
int oldarray = 0; //old position of servo array (for all arrays)

int pos = 0;    // variable to store the servo position

int buccal180array[]={0,2,4,6,8,10,12,14,16,18,20,22,24,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4,2};
int oper180array[]={23,22,21,20,19,18,17,16,15,14,13,12,11,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25,24};
int buccal180offset10[]={0,2,4,6,8,10,12,14,16,18,20,22,24,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2,};
int oper180offset10[]={10,9,8,7,6,5,4,3,2,1,0,1,2,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11,};
int buccal180offset2[]={0,2,4,6,8,10,12,14,16,18,20,22,24,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2,};
int oper180offset2[]={2,1,0,1,2,3,4,5,6,7,8,9,10,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3,};
int buccal270insp2[]={0,2,4,6,8,10,12,14,16,18,20,22,24,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1,};
int oper270insp2[]={5,5,4,4,3,3,2,2,1,1,0,0,1,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6,};

void setup() 
{ 
  Serial.begin(115200); // initialize serial communication at 115200 bits per second
  buccalservo.attach(9);  
  operservo.attach(5);
  brmservo.attach(6); 
} 
 
 
void loop() 
{ 
  unsigned long curmillis = millis();
  unsigned long curmillisservo = millis();
  
  if(curmillis - prevmillis > pressureinterval){
    prevmillis = curmillis;
     int buccalpressure = analogRead(A0);
     int operpressure = analogRead(A1);  
     Serial.print("Buccal: ");
     Serial.print(buccalpressure);
     Serial.print("\t Opercular: ");
     Serial.print(operpressure);
     Serial.print("\t Buccal Servo: ");
     Serial.print(buccal180array[oldarray]); 
     Serial.print("\t Opercular Servo: ");
     Serial.print(oper180array[oldarray]);
     Serial.print("\t BRM Servo: ");
     Serial.print(oper180array[oldarray]);  
     Serial.print("\t Time: ");
     Serial.println(curmillis); //prints time since program started
  
  if(curmillisservo - prevmillisservo > servointerval){
    prevmillisservo = curmillisservo;
    
    int newarray = oldarray + 1;   //new position of servo array
    
    if(newarray - oldarray > 0){
      
      for(pos = oldarray; pos < newarray; pos++)   //pos = array value; in steps of one array position
      {                                
        buccalservo.write(buccal180array[pos]);  //calling array values using pos variable    
        operservo.write(oper180array[pos]);
        brmservo.write(oper180array[pos]);
        
        if(newarray < 179){   
          
          oldarray = newarray;
        }
        
        else{
          oldarray = 0;
        }
      }  
    }
  }
  }  
  
  
} 
